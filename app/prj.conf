## CMakeLists.txt
```
# SPDX-License-Identifier: Apache-2.0

cmake_minimum_required(VERSION 3.28.0)

find_package(Zephyr REQUIRED HINTS $ENV{ZEPHYR_BASE})

target_include_directories(app PRIVATE ${ZEPHYR_BASE}/subsys/net/lib)

project(esp32p4_ptp)
target_sources(app PRIVATE src/main.c src/ptp_diag.c src/ptp_prio.c src/ptp_fault.c)
```

## prj.conf
```kconfig
CONFIG_NETWORKING=y
CONFIG_NET_LOG=y
CONFIG_LOG=y
CONFIG_NET_IPV4=y
CONFIG_NET_IPV6=n
CONFIG_NET_DHCPV4=n
CONFIG_NET_UDP=y

CONFIG_TEST_RANDOM_GENERATOR=y

CONFIG_NET_PKT_RX_COUNT=32
CONFIG_NET_PKT_TX_COUNT=32
CONFIG_NET_BUF_RX_COUNT=32
CONFIG_NET_BUF_TX_COUNT=32
CONFIG_NET_MAX_CONTEXTS=10

CONFIG_INIT_STACKS=y
CONFIG_PRINTK=y
CONFIG_NET_SHELL=y
CONFIG_LOG_MODE_DEFERRED=y

# Ethernet is needed for PTP
CONFIG_ETH_DRIVER=y

CONFIG_NET_CONFIG_NEED_IPV4=y
CONFIG_NET_CONFIG_SETTINGS=y

# First ethernet interface will use these settings
CONFIG_NET_CONFIG_MY_IPV4_ADDR="192.168.40.101"
CONFIG_NET_CONFIG_PEER_IPV4_ADDR="192.168.40.50"

# PTP settings
CONFIG_PTP_CLOCK=y
CONFIG_PTP=y
CONFIG_PTP_ANNOUNCE_RECV_TIMEOUT=5
CONFIG_PTP_LOG_LEVEL_DBG=y
CONFIG_PTP_DSCP_HIGH_PRIORITY=y

# Servo gains (thousandths). The 0.7/0.3 default rings after a bad sample
# because the unfiltered delay feeds back into the offset; 0.3/0.05 halves
# steady-state noise without ringing. See FINDINGS.md, "PI gain tuning".
CONFIG_PRECISION_TIMING_PI_KP=300
CONFIG_PRECISION_TIMING_PI_KI=50

# Foreign-master records are only freed when the port closes, so the pool must
# hold every board that can ever become master (the default 5 caused split
# brain with 7 boards rotating; see FINDINGS.md, "Resync soak"): 6 other
# boards + a host ptp4l, with a spare.
CONFIG_PTP_FOREIGN_TIME_TRANSMITTER_RECORD_SIZE=8
# Each record keeps up to ~3 Announces from the PTP message pool, and
# ptp_msg_alloc() blocks forever when the pool is empty, deadlocking the PTP
# thread (the only thing that frees messages). Size the pool for 8 records x
# 3 + ~10 in flight, with headroom. 1,576 bytes per message.
CONFIG_PTP_MSG_POLL_SIZE=40

# PTP sample settings
CONFIG_NET_SHELL_PTP_SUPPORTED=y
CONFIG_PTP_CLOCK_SHELL=y
CONFIG_NET_SAMPLE_RUN_DURATION=0
CONFIG_NET_CONFIG_MY_IPV4_NETMASK="255.255.255.0"

# Bring-up/debug helpers
CONFIG_MDIO_SHELL=y
CONFIG_DEVMEM_SHELL=y
```

## smp.conf
```kconfig
# Experimental SMP on both HP cores (zephyr#120181 + #120082).
# Selected by TREE=smp ./build.sh, which also points ZEPHYR_BASE at the
# ~/zephyr-p4/smp worktrees.
CONFIG_SMP=y

# Per-CPU and per-thread runtime accounting for the `core1` shell command
CONFIG_THREAD_RUNTIME_STATS=y
CONFIG_SCHED_THREAD_USAGE_ALL=y
```

## boards/waveshare_esp32p4_eth_esp32p4_hpcore.conf
```kconfig
# Use the native Synopsys DWC MAC driver (drivers/ethernet/dwc_mac) rather
# than the HAL-based eth_esp32.c, whose PTP clock can't be rate-adjusted
# upward (see FINDINGS.md). DRIVER=esp32 ./build.sh overrides this.
CONFIG_ETH_ESP32=n
```

## boards/waveshare_esp32p4_eth_esp32p4_hpcore.overlay
```dts
/*
 * IP101GRI needs a real reset pulse and settling time before MDIO access.
 * Upstream board DTS leaves both at 0, so phy_mii probes a PHY that is
 * still in reset and fails with "No PHY found at address 1".
 */
&phy {
	reset-assert-duration-us = <10000>;
	reset-deassertion-timeout-ms = <20>;
};
```

## src/core1_test.c
```c
/*
 * SMP experiment: a thread pinned to CPU1 that polls the EMAC's internal
 * PPS level (HP_SYSTEM_GMAC_CTRL0.PTP_PPS). On v1.3 silicon that signal
 * can't reach a pin through the GPIO matrix, so a dedicated core copying it
 * out is one way to get a PPS output. This measures how tight such a loop
 * can be; it doesn't drive any pin.
 *
 * Shell: `core1` prints per-CPU busy % since the previous call and the
 * thread's counters.
 */

#include <zephyr/arch/riscv/csr.h>
#include <zephyr/kernel.h>
#include <zephyr/shell/shell.h>
#include <zephyr/sys/sys_io.h>

#define EMAC_PTP_PPS_CTRL_REG 0x5009872CUL /* EMAC PTP base + 0x2c */
#define PPS_CMD0_MASK         0xFU
#define PPS_CMD0_1HZ          1U /* 1 Hz square wave with digital rollover */
#define HP_SYS_GMAC_CTRL0_REG 0x500E514CUL /* bit 0: PTP_PPS level (RO) */
#define CPU_HZ                400000000ULL
#define TEST_CPU              1

static struct {
	uint64_t iterations;
	uint64_t on_cpu[CONFIG_MP_MAX_NUM_CPUS];
	uint32_t period_min;
	uint32_t period_max;
	uint64_t period_sum;
	uint32_t pps_edges;
} stats;

static struct k_spinlock stats_lock;

K_THREAD_STACK_DEFINE(core1_stack, 1024);
static struct k_thread core1_thread;

static void core1_loop(void *p1, void *p2, void *p3)
{
	uint32_t prev = csr_read(mcycle);
	int level = sys_read32(HP_SYS_GMAC_CTRL0_REG) & 1;

	ARG_UNUSED(p1);
	ARG_UNUSED(p2);
	ARG_UNUSED(p3);

	while (true) {
		int now_level = sys_read32(HP_SYS_GMAC_CTRL0_REG) & 1;
		uint32_t now = csr_read(mcycle);
		uint32_t period = now - prev;
		k_spinlock_key_t key = k_spin_lock(&stats_lock);

		prev = now;
		stats.iterations++;
		stats.on_cpu[arch_curr_cpu()->id]++;
		stats.period_sum += period;
		if (period < stats.period_min) {
			stats.period_min = period;
		}
		if (period > stats.period_max) {
			stats.period_max = period;
		}
		if (now_level != level) {
			stats.pps_edges++;
			level = now_level;
		}
		k_spin_unlock(&stats_lock, key);
	}
}

static int core1_init(void)
{
	sys_write32((sys_read32(EMAC_PTP_PPS_CTRL_REG) & ~PPS_CMD0_MASK) | PPS_CMD0_1HZ,
		    EMAC_PTP_PPS_CTRL_REG);

	stats.period_min = UINT32_MAX;

	k_thread_create(&core1_thread, core1_stack, K_THREAD_STACK_SIZEOF(core1_stack),
			core1_loop, NULL, NULL, NULL, K_LOWEST_APPLICATION_THREAD_PRIO, 0,
			K_FOREVER);
	k_thread_name_set(&core1_thread, "core1_test");
	k_thread_cpu_pin(&core1_thread, TEST_CPU);
	k_thread_start(&core1_thread);

	return 0;
}

SYS_INIT(core1_init, APPLICATION, CONFIG_APPLICATION_INIT_PRIORITY);

static k_thread_runtime_stats_t prev_cpu[CONFIG_MP_MAX_NUM_CPUS];

static unsigned int pct(uint64_t part, uint64_t whole)
{
	return whole ? (unsigned int)(part * 100 / whole) : 0;
}

static uint32_t cyc_to_ns(uint64_t cyc)
{
	return (uint32_t)(cyc * 1000000000ULL / CPU_HZ);
}

static int cmd_core1(const struct shell *sh, size_t argc, char **argv)
{
	k_thread_runtime_stats_t cur, thr;
	k_spinlock_key_t key;
	typeof(stats) snap;

	ARG_UNUSED(argc);
	ARG_UNUSED(argv);

	for (int cpu = 0; cpu < CONFIG_MP_MAX_NUM_CPUS; cpu++) {
		k_thread_runtime_stats_cpu_get(cpu, &cur);
		uint64_t all = cur.execution_cycles - prev_cpu[cpu].execution_cycles;
		uint64_t busy = cur.total_cycles - prev_cpu[cpu].total_cycles;

		shell_print(sh, "cpu%d: busy %u%% since last call", cpu, pct(busy, all));
		prev_cpu[cpu] = cur;
	}

	k_thread_runtime_stats_get(&core1_thread, &thr);

	key = k_spin_lock(&stats_lock);
	snap = stats;
	k_spin_unlock(&stats_lock, key);

	shell_print(sh, "core1_test: iterations %llu (cpu0 %llu, cpu1 %llu), runtime cycles %llu",
		    snap.iterations, snap.on_cpu[0], snap.on_cpu[1], thr.execution_cycles);
	if (snap.iterations > 0) {
		shell_print(sh, "core1_test: loop period min %u ns avg %u ns max %u ns",
			    cyc_to_ns(snap.period_min),
			    cyc_to_ns(snap.period_sum / snap.iterations),
			    cyc_to_ns(snap.period_max));
	}
	shell_print(sh, "core1_test: PPS edges seen %u", snap.pps_edges);

	return 0;
}

SHELL_CMD_REGISTER(core1, NULL, "CPU1 pinned-thread test stats", cmd_core1);
```

## src/ptp_diag.c
```c
/*
 * Shell command `ptp_diag`: read-only snapshot of the PTP thread and its
 * wakeup path, for catching the stall where the thread stays blocked in
 * zsock_poll() while port timeouts are pending.
 *
 * Every output line starts with "diag:" so a host-side monitor can pick them
 * out of the interleaved log stream. The only side effect is a zero-timeout
 * poll on each descriptor, which reports readiness without consuming data.
 */

#include <string.h>

#include <zephyr/kernel.h>
#include <zephyr/net/socket.h>
#include <zephyr/shell/shell.h>

#include "ptp/clock.h"
#include "ptp/port.h"

static struct k_thread *ptp_tid;

static void find_ptp_thread(const struct k_thread *thread, void *user_data)
{
	const char *name = k_thread_name_get((k_tid_t)thread);

	ARG_UNUSED(user_data);

	if (name != NULL && strcmp(name, "PTP") == 0) {
		ptp_tid = (struct k_thread *)thread;
	}
}

static int fd_ready(int fd)
{
	struct zsock_pollfd pfd = { .fd = fd, .events = ZSOCK_POLLIN };
	int ret = zsock_poll(&pfd, 1, 0);

	return ret < 0 ? ret : pfd.revents;
}

static int cmd_ptp_diag(const struct shell *sh, size_t argc, char **argv)
{
	const struct zsock_pollfd *pfds;
	struct ptp_port *port;
	size_t count;
	bool valid;
	int work_busy;
	char state[32];

	ARG_UNUSED(argc);
	ARG_UNUSED(argv);

	shell_print(sh, "diag: uptime_ms=%lld", k_uptime_get());

	k_thread_foreach_unlocked(find_ptp_thread, NULL);
	if (ptp_tid != NULL) {
		shell_print(sh, "diag: thread tid=%p state=%s pended_on=%p", ptp_tid,
			    k_thread_state_str(ptp_tid, state, sizeof(state)),
			    ptp_tid->base.pended_on);
	} else {
		shell_print(sh, "diag: thread not found");
	}

	pfds = ptp_clock_diag_pollfds(&count, &valid, &work_busy);
	shell_print(sh, "diag: wakeup work_busy=0x%x pollfd_valid=%d", work_busy, valid);
	for (size_t i = 0; i < count; i++) {
		shell_print(sh, "diag: pollfd[%u] fd=%d events=0x%x revents=0x%x ready_now=0x%x",
			    (unsigned int)i, pfds[i].fd, pfds[i].events, pfds[i].revents,
			    fd_ready(pfds[i].fd));
	}

	SYS_SLIST_FOR_EACH_CONTAINER(ptp_clock_ports_list(), port, node) {
		shell_print(sh,
			    "diag: port %u state=%d timeouts=0x%lx "
			    "remaining_ms ann=%u delay=%u sync=%u "
			    "seq ann=%u delay=%u sync=%u",
			    port->port_ds.id.port_number, ptp_port_state(port),
			    (unsigned long)atomic_get(&port->timeouts),
			    k_timer_remaining_get(&port->timers.announce),
			    k_timer_remaining_get(&port->timers.delay),
			    k_timer_remaining_get(&port->timers.sync), port->seq_id.announce,
			    port->seq_id.delay, port->seq_id.sync);
	}

	return 0;
}

SHELL_CMD_REGISTER(ptp_diag, NULL, "Snapshot PTP thread and wakeup state", cmd_ptp_diag);
```

## src/ptp_fault.c
```c
/*
 * PTP fault injection (debug). Overrides the stack's ptp_fault_rx() hook
 * (patches/zephyr/0003) to drop or skew received PTP messages on this board.
 *
 *   ptp_fault                              show rules and counters
 *   ptp_fault drop <type> <percent>        drop that share of received <type>
 *   ptp_fault delay sync <ns> [count]      Sync RX timestamp t2 += ns
 *                                          (a Sync queued in the network:
 *                                          offset reads +ns)
 *   ptp_fault delay dresp <ns> [count]     Delay_Resp receiveTimestamp t4 += ns
 *                                          (a queued Delay_Req: delay +ns/2,
 *                                          offset -ns/2)
 *   ptp_fault off                          clear all rules and counters
 *
 * <type>: sync fup dreq dresp announce. count: messages to skew, default 1
 * (a single bad sample); 0 means every message until cleared.
 *
 * Rules apply to messages this board receives. Delay_Resp rules only touch
 * responses to this board's own Delay_Req (every board receives all of them
 * in multicast mode), so "drop dresp" on one slave hides its responses only;
 * "drop dreq" on the GM affects every slave. Counters for dreq on a slave
 * include other slaves' requests.
 */

#include <stdlib.h>
#include <string.h>

#include <zephyr/kernel.h>
#include <zephyr/random/random.h>
#include <zephyr/shell/shell.h>

#include "ptp/msg.h"
#include "ptp/port.h"

enum fault_type { F_SYNC, F_FUP, F_DREQ, F_DRESP, F_ANNOUNCE, F_COUNT };

static const struct {
	const char *name;
	enum ptp_msg_type type;
} types[F_COUNT] = {
	[F_SYNC] = {"sync", PTP_MSG_SYNC},
	[F_FUP] = {"fup", PTP_MSG_FOLLOW_UP},
	[F_DREQ] = {"dreq", PTP_MSG_DELAY_REQ},
	[F_DRESP] = {"dresp", PTP_MSG_DELAY_RESP},
	[F_ANNOUNCE] = {"announce", PTP_MSG_ANNOUNCE},
};

static struct {
	uint8_t drop_pct;
	int32_t delay_ns;
	int32_t delay_left;	/* <0: unlimited */
	uint32_t seen, dropped, delayed;
} rule[F_COUNT];

static void ts_add(struct net_ptp_time *ts, int64_t ns)
{
	int64_t total = (int64_t)ts->nanosecond + ns;
	int64_t sec = (int64_t)ts->second + total / NSEC_PER_SEC;

	total %= NSEC_PER_SEC;
	if (total < 0) {
		total += NSEC_PER_SEC;
		sec--;
	}
	ts->second = (uint64_t)sec;
	ts->nanosecond = (uint32_t)total;
}

bool ptp_fault_rx(struct ptp_port *port, struct ptp_msg *msg)
{
	enum ptp_msg_type t = ptp_msg_type(msg);
	int f;

	for (f = 0; f < F_COUNT && types[f].type != t; f++) {
	}
	if (f == F_COUNT) {
		return false;
	}

	/* In multicast mode every board receives every slave's Delay_Resp; only
	 * the ones answering this port's Delay_Req matter (the stack ignores the
	 * rest), so leave the others alone and uncounted.
	 */
	if (f == F_DRESP && !ptp_port_id_eq(&msg->delay_resp.req_port_id, &port->port_ds.id)) {
		return false;
	}

	rule[f].seen++;

	if (rule[f].drop_pct && (sys_rand32_get() % 100) < rule[f].drop_pct) {
		rule[f].dropped++;
		return true;
	}

	if (rule[f].delay_ns && rule[f].delay_left != 0) {
		if (f == F_SYNC) {
			ts_add(&msg->timestamp.host, rule[f].delay_ns);
		} else if (f == F_DRESP) {
			ts_add(&msg->timestamp.protocol, rule[f].delay_ns);
		}
		rule[f].delayed++;
		if (rule[f].delay_left > 0) {
			rule[f].delay_left--;
		}
	}

	return false;
}

static int find_type(const struct shell *sh, const char *name)
{
	for (int f = 0; f < F_COUNT; f++) {
		if (strcmp(name, types[f].name) == 0) {
			return f;
		}
	}
	shell_error(sh, "unknown type '%s' (sync fup dreq dresp announce)", name);
	return -EINVAL;
}

static int cmd_show(const struct shell *sh)
{
	for (int f = 0; f < F_COUNT; f++) {
		shell_print(sh, "%-8s drop %3u%%  delay %+d ns (left %s%d)  seen %u dropped %u "
			    "delayed %u",
			    types[f].name, rule[f].drop_pct, rule[f].delay_ns,
			    rule[f].delay_left < 0 ? "inf " : "", rule[f].delay_left < 0 ? 0
			    : rule[f].delay_left, rule[f].seen, rule[f].dropped, rule[f].delayed);
	}
	return 0;
}

static int cmd_ptp_fault(const struct shell *sh, size_t argc, char **argv)
{
	int f;

	if (argc == 1) {
		return cmd_show(sh);
	}

	if (strcmp(argv[1], "off") == 0) {
		memset(rule, 0, sizeof(rule));
		shell_print(sh, "all faults cleared");
		return 0;
	}

	if (strcmp(argv[1], "drop") == 0 && argc == 4) {
		long pct = strtol(argv[3], NULL, 0);

		f = find_type(sh, argv[2]);
		if (f < 0) {
			return f;
		}
		if (pct < 0 || pct > 100) {
			shell_error(sh, "percent must be 0-100");
			return -EINVAL;
		}
		rule[f].drop_pct = (uint8_t)pct;
		shell_print(sh, "dropping %ld%% of received %s", pct, types[f].name);
		return 0;
	}

	if (strcmp(argv[1], "delay") == 0 && (argc == 4 || argc == 5)) {
		long ns = strtol(argv[3], NULL, 0);
		long count = argc == 5 ? strtol(argv[4], NULL, 0) : 1;

		f = find_type(sh, argv[2]);
		if (f < 0) {
			return f;
		}
		if (f != F_SYNC && f != F_DRESP) {
			shell_error(sh, "delay supports sync and dresp only");
			return -EINVAL;
		}
		rule[f].delay_ns = (int32_t)ns;
		rule[f].delay_left = count == 0 ? -1 : (int32_t)count;
		if (count == 0) {
			shell_print(sh, "skewing every %s by %+ld ns", types[f].name, ns);
		} else {
			shell_print(sh, "skewing the next %ld %s by %+ld ns", count, types[f].name,
				    ns);
		}
		return 0;
	}

	shell_error(sh, "usage: ptp_fault [off | drop <type> <pct> | delay sync|dresp <ns> "
			"[count]]");
	return -EINVAL;
}

SHELL_CMD_ARG_REGISTER(ptp_fault, NULL,
		       "PTP fault injection: [off | drop <type> <pct> | delay sync|dresp <ns> "
		       "[count]]",
		       cmd_ptp_fault, 1, 4);
```

## src/ptp_prio.c
```c
/*
 * Shell command `ptp_prio`: show or change this clock's priority1/priority2
 * at runtime, then re-run the best-master decision so a grandmaster change
 * takes effect immediately instead of at the next Announce.
 *
 *   ptp_prio              show priority1/priority2 and the port state
 *   ptp_prio <p1> [<p2>]  set them (0-255; lower wins)
 *
 * Not persistent: a reboot restores CONFIG_PTP_PRIORITY1/2 (see GM= in
 * build.sh).
 */

#include <stdlib.h>

#include <zephyr/shell/shell.h>

#include "ptp/clock.h"
#include "ptp/port.h"

static int parse_prio(const struct shell *sh, const char *arg, uint8_t *out)
{
	char *end;
	long v = strtol(arg, &end, 0);

	if (*arg == '\0' || *end != '\0' || v < 0 || v > 255) {
		shell_error(sh, "invalid priority '%s' (0-255)", arg);
		return -EINVAL;
	}
	*out = (uint8_t)v;
	return 0;
}

static int cmd_ptp_prio(const struct shell *sh, size_t argc, char **argv)
{
	/* The stack exposes the default dataset read-only; the object itself is
	 * writable and the management SET PRIORITY1 handler writes it the same way.
	 */
	struct ptp_default_ds *dds = (struct ptp_default_ds *)ptp_clock_default_ds();
	struct ptp_port *port;
	uint8_t p1 = dds->priority1;
	uint8_t p2 = dds->priority2;

	if (argc > 1) {
		if (parse_prio(sh, argv[1], &p1) < 0 ||
		    (argc > 2 && parse_prio(sh, argv[2], &p2) < 0)) {
			return -EINVAL;
		}
		dds->priority1 = p1;
		dds->priority2 = p2;
		ptp_clock_state_decision_req();
	}

	shell_print(sh, "priority1 %u priority2 %u", dds->priority1, dds->priority2);
	SYS_SLIST_FOR_EACH_CONTAINER(ptp_clock_ports_list(), port, node) {
		shell_print(sh, "port %u state %d (re-evaluated%s)", port->port_ds.id.port_number,
			    ptp_port_state(port), argc > 1 ? "" : " at next Announce");
	}

	return 0;
}

SHELL_CMD_ARG_REGISTER(ptp_prio, NULL,
		       "Show or set PTP priority1 [priority2] (0-255, lower wins); not persistent",
		       cmd_ptp_prio, 1, 2);
```
